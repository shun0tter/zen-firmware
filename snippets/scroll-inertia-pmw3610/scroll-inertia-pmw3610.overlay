#include <dt-bindings/zmk/input_transform.h>

// Central only: zmk-input-processor-scroll-inertia fails the build on a peripheral.
// Apply after input-trackball-pmw3610; this replaces its scroller chain.

/ {
    scroll_inertia: scroll_inertia {
        compatible = "zmk,input-processor-scroll-inertia";
        #input-processor-cells = <0>;
        axis = <0>;
        layer = <4>;
        scale = <1>;
        scale-div = <15>;
        track-remainders;
    };
};

&pointing_listener {
    scroller {
        input-processors =
            <&zip_xy_transform (INPUT_TRANSFORM_XY_SWAP | INPUT_TRANSFORM_Y_INVERT)>,
            <&zip_xy_to_scroll_mapper>,
            <&scroll_inertia>,
            <&pmw3610_scroll_scaler 1 15>;
    };
};
